## modules/fakee/Kconfig
```kconfig
# Copyright (c) 2025 Vladislav Zilkov <vladislav.zilkov@intel.com>
# SPDX-License-Identifier: Apache-2.0

config HWW_FAKEE
        bool "FAKEE Hardware driver"
        default n
        help
          Enables driver for the FAKEE prints as a hardware device. 
```

## modules/fakee/dts/bindings/fakee/fakeeab,hww.yaml
```yaml
# Copyright (c) 2025 Vladislav Zilkov <vladislav.zilkov@intel.com>
# SPDX-License-Identifier: Apache-2.0

compatible: "fakeea,hww"
description: HWW Fakee driver for prints
```
