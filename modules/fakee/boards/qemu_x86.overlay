/{
    hw_fake: hw_fake {
			compatible = "fake,hw";
			status = "okay";
			label = "HW_FAKE";
	};

	hww_fakee: hww_fakee {
			compatible = "fakeee,hwww";
			status = "okay";
			label = "HWW_FAKEE";
	};


	aliases {
		my-hw = &hww_fakee;
	};
};
