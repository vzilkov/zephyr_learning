## CMakeLists.txt
```
# SPDX-License-Identifier: Apache-2.0
cmake_minimum_required(VERSION 3.20.0)

message("Zephyr base is: $ENV{ZEPHYR_BASE}")
message("Zephyr modules are: ${ZEPHYR_MODULES}")

find_package(Zephyr REQUIRED HINTS $ENV{ZEPHYR_BASE})
# set(LINKER_SCRIPT "${CMAKE_CURRENT_SOURCE_DIR}/linker.ld")
# set_target_properties(app PROPERTIES LINK_DEPENDS ${LINKER_SCRIPT})

project(own_project)
target_sources(app PRIVATE src/main.c)

add_subdirectory(semaphores_and_mutexes_exercise)
target_link_libraries(app PRIVATE sem_and_mutexes_exercise_lib)

add_subdirectory(threads_exercise)
target_link_libraries(app PRIVATE threads_exercise_lib kernel)

target_compile_options(app PRIVATE -Og)
```

## prj.conf
```kconfig
# enable to use thread names
CONFIG_THREAD_NAME=n
CONFIG_SCHED_CPU_MASK=y

CONFIG_TIMESLICING=y
CONFIG_QEMU_ICOUNT=y
CONFIG_TIMESLICE_SIZE=1
CONFIG_TIMESLICE_PRIORITY=0
CONFIG_SYS_CLOCK_TICKS_PER_SEC=5

CONFIG_STDOUT_CONSOLE=y
CONFIG_LOG=n
CONFIG_PRINTK=y
CONFIG_LOG_BACKEND_UART=n

CONFIG_HW_FAKE=y #in zephyr folder
CONFIG_HWW_FAKEE=y #module
```

## boards/qemu_x86.overlay
```dts
/{
    hw_fake {
			compatible = "fake,hw";
			status = "okay";
			label = "HW_FAKE";
		};

	hww_fakee {
		compatible = "fakee,hww";
			status = "okay";
			label = "HWW_FAKEE";
	};
};
```

## dts/bindings/fakee/fakee,hww.yaml
```yaml
# Copyright (c) 2025 Vladislav Zilkov <vladislav.zilkov@intel.com>
# SPDX-License-Identifier: Apache-2.0

compatible: "fakee,hww"
description: HWW Fakee driver for prints
```

## src/main.c
```c
/* main.c - Synchronization demo */

/*
 * Copyright (c) 2012-2014 Wind River Systems, Inc.
 *
 * SPDX-License-Identifier: Apache-2.0
 */

#include <zephyr/kernel.h>
#include <zephyr/sys/printk.h>
#include "threads.h"

#define HELLO_THREAD1_STACK_SIZE 1024
#define HELLO_THREAD1_PRIO 5
K_THREAD_STACK_DEFINE(hello_thread1_stack, HELLO_THREAD1_STACK_SIZE);
struct k_thread hello_thread1_data;

#define HELLO_THREAD2_STACK_SIZE 1024
#define HELLO_THREAD2_PRIO 5
K_THREAD_STACK_DEFINE(hello_thread2_stack, HELLO_THREAD2_STACK_SIZE);
struct k_thread hello_thread2_data;

#define MSG_QUEUE_SIZE 10
#define MSG_SIZE sizeof(int)
K_MSGQ_DEFINE(my_msgq, MSG_SIZE, MSG_QUEUE_SIZE, 4);

int main(void)
{
	k_thread_create(&hello_thread1_data, hello_thread1_stack, HELLO_THREAD1_STACK_SIZE,
					hello_thread1, (struct k_msgq*) &my_msgq, NULL, NULL, HELLO_THREAD1_PRIO, 0, K_MSEC(1));
	k_thread_create(&hello_thread2_data, hello_thread2_stack, HELLO_THREAD2_STACK_SIZE,
					hello_thread2, (struct k_msgq*) &my_msgq, NULL, NULL, HELLO_THREAD2_PRIO, 0, K_MSEC(0));
	
	// k_thread_start(&hello_thread2_data);
	// k_thread_start(&hello_thread1_data);
	
	return 0;
}
```
